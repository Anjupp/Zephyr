## CMakeLists.txt
```
# Minimum CMake version
cmake_minimum_required(VERSION 3.20.0)

# Add additional modules 
set(ZEPHYR_EXTRA_MODULES "${CMAKE_SOURCE_DIR}/../../modules/ad74416h")

# Locate the Zephyr RTOS source 
find_package(Zephyr REQUIRED HINTS $ENV{ZEPHYR_BASE})

# Name the project
project(ReadID_ad74416h)

# Locate the source code for the application
target_sources(app PRIVATE src/main.c)
```

## prj.conf
```kconfig
CONFIG_GPIO=y
CONFIG_SENSOR=y
CONFIG_SPI=y
CONFIG_AD74416H=y
CONFIG_LOG=y
CONFIG_LOG_DEFAULT_LEVEL=4
CONFIG_CRC=y
CONFIG_NO_OPTIMIZATIONS=y
```

## src/main.c
```c
#include <zephyr/kernel.h>
#include <zephyr/device.h>
#include <zephyr/drivers/sensor.h>
#include <stdio.h>

int main(void)
{
    const struct device *const ad744 = DEVICE_DT_GET(DT_ALIAS(my_ad74416h));
    int ret;

    if (ad744 == NULL) {
        printf ("AD74416H not found \n");
        return 0;
    }
    // printf ("AD74416H is found\n");

    if (!device_is_ready(ad744)) {
        printf("Device %s is not ready\n", ad744->name);
        return 0;
    }

    return 0;
}
```
