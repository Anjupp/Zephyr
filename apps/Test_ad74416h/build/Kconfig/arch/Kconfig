## apps/Test_ad74416h/build/Kconfig/arch/Kconfig
```kconfig
# Load arch Kconfig descriptions.
osource "C:/Users/APuthenp/zephyrproject/zephyr/arch/x86/Kconfig"
osource "C:/Users/APuthenp/zephyrproject/zephyr/arch/xtensa/Kconfig"
osource "C:/Users/APuthenp/zephyrproject/zephyr/arch/sparc/Kconfig"
osource "C:/Users/APuthenp/zephyrproject/zephyr/arch/riscv/Kconfig"
osource "C:/Users/APuthenp/zephyrproject/zephyr/arch/posix/Kconfig"
osource "C:/Users/APuthenp/zephyrproject/zephyr/arch/nios2/Kconfig"
osource "C:/Users/APuthenp/zephyrproject/zephyr/arch/mips/Kconfig"
osource "C:/Users/APuthenp/zephyrproject/zephyr/arch/arm64/Kconfig"
osource "C:/Users/APuthenp/zephyrproject/zephyr/arch/arm/Kconfig"
osource "C:/Users/APuthenp/zephyrproject/zephyr/arch/arc/Kconfig"
```

## modules/ad74416h/drivers/ad74416h/Kconfig
```kconfig
# Create a new option in menuconfig
config AD74416H
    bool "AD74416H Software IO"
    default n         # set the driver to be disabled by default
    depends on SPI    # Make it dependent on SPI
    help 
      Enable driver for the AD74416H. This driver depends on SPI
```

## modules/ad74416h/dts/bindings/adi,ad74416h.yaml
```yaml
# Description of the device
description: Analog Devices Software IO

# Compatibility string that matches the one in the Devicetree source and 
# DT_DRV_COMPAT macro in the driver source code
compatible: "adi,ad74416h"

# Include common definitions from other bindings files
# - sensor-device.yaml - common sensor properties
# - spi-device.yaml - common SPI communication properties
include: [sensor-device.yaml, spi-device.yaml]

# Define specific Devicetree properties of the AD74416H
properties: 

 # cs-gpios:
  #  type: phandle-array
   # required: true
    #description: GPIO pin used for chip select (CS) for the device.

  dev_addr:
    type: int
    default: 0
    description: Device address
    enum:
      - 0
      - 1
      - 2
      - 3
```
